## sdkconfig.defaults
```kconfig
# ESP32-C6 Configuration
CONFIG_IDF_TARGET="esp32c6"

# USB Serial JTAG Configuration
CONFIG_ESP_CONSOLE_USB_SERIAL_JTAG=y
CONFIG_ESP_CONSOLE_SECONDARY_NONE=y

# TWAI (CAN) Configuration
CONFIG_TWAI_ISR_IN_IRAM=y

# FreeRTOS Configuration
CONFIG_FREERTOS_HZ=1000

# Compiler options
CONFIG_COMPILER_OPTIMIZATION_SIZE=y

# Log output
CONFIG_LOG_DEFAULT_LEVEL_INFO=y
CONFIG_LOG_MAXIMUM_LEVEL_VERBOSE=y

# Partition table
CONFIG_PARTITION_TABLE_CUSTOM=y
CONFIG_PARTITION_TABLE_CUSTOM_FILENAME="partitions.csv"
CONFIG_PARTITION_TABLE_FILENAME="partitions.csv"

# Main task stack size
CONFIG_ESP_MAIN_TASK_STACK_SIZE=4096

# USB Serial JTAG buffer size
CONFIG_USB_SERIAL_JTAG_TX_BUFFER_SIZE=1024
CONFIG_USB_SERIAL_JTAG_RX_BUFFER_SIZE=1024
```
